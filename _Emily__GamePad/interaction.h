


int interaction[numLevels][tileW * tileH] {
  // Level 0 - Front 
  // 0x01 = marker for door
  // 0x02 = correct car 
  {
    0xFF, 0xFF, 0xFF, 0xFF, 0xFF, 0xFF, 0xFF, 0xFF, 0xFF, 0xFF, 0xFF, 0xFF, 0xFF, 0xFF, 0xFF, 0xFF,
    0xFF, 0xFF, 0xFF, 0xFF, 0xFF, 0xFF, 0xFF, 0xFF, 0xFF, 0xFF, 0xFF, 0xFF, 0xFF, 0xFF, 0xFF, 0xFF,
    0xFF, 0xFF, 0xFF, 0xFF, 0xFF, 0xFF, 0xFF, 0xFF, 0xFF, 0xFF, 0xFF, 0xFF, 0xFF, 0xFF, 0xFF, 0xFF,
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    0xFF, 0xFF, 0xFF, 0xFF, 0xFF, 0xFF, 0xFF, 0xFF, 0xFF, 0xFF, 0xFF, 0xFF, 0xFF, 0xFF, 0xFF, 0xFF,
  }, {
    //Level 1 - reception room 
    // 0x04 = treats 
    // 0x02 = door into room
    // 0x03 = door out of room 
    0xFF, 0xFF, 0xFF, 0xFF, 0xFF, 0xFF, 0xFF, 0xFF, 0xFF, 0x03, 0x03, 0x03, 0xFF, 0xFF, 0xFF, 0xFF,
    0xFF, 0x00, 0x00, 0x00, 0x00, 0x00, 0x00, 0x00, 0x00, 0x00, 0x00, 0x00, 0x00, 0x00, 0x00, 0xFF,
    0xFF, 0x00, 0x00, 0x00, 0x00, 0x00, 0x00, 0x00, 0x00, 0x00, 0x00, 0x00, 0x00, 0x00, 0x00, 0xFF,
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    0xFF, 0xFF, 0xFF, 0xFF, 0xFF, 0xFF, 0x02, 0x02, 0x02, 0xFF, 0xFF, 0xFF, 0xFF, 0xFF, 0xFF, 0xFF,
  }, {
    //Level 2 - checkup room 
    // 0x06 = door to the surgical room
    // 0x07 = door to the boarding room 
    // 0x08 = door to the grooming room 
    // 0x04 = door into the checkup room 
    0xFF, 0xFF, 0xFF, 0xFF, 0xFF, 0x07, 0x07, 0x07, 0xFF, 0xFF, 0xFF, 0xFF, 0xFF, 0xFF, 0xFF, 0xFF,
    0x06, 0x00, 0x00, 0x00, 0x00, 0x00, 0x00, 0x00, 0x00, 0x00, 0x00, 0x00, 0x00, 0x00, 0x00, 0x08,
    0x06, 0x00, 0x00, 0x00, 0x00, 0x00, 0x00, 0x00, 0x00, 0x00, 0x00, 0x00, 0x00, 0x00, 0x00, 0x08,
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    0xFF, 0xFF, 0xFF, 0xFF, 0xFF, 0xFF, 0xFF, 0xFF, 0xFF, 0x04, 0x04, 0x04, 0xFF, 0xFF, 0xFF, 0xFF,
  },{
  // Level 3- surgical room
  // 0x06 = door to checkup room   
    0xFF, 0xFF, 0xFF, 0xFF, 0xFF, 0xFF, 0xFF, 0xFF, 0xFF, 0xFF, 0xFF, 0xFF, 0xFF, 0xFF, 0xFF, 0xFF,
    0xFF, 0xFF, 0x00, 0x00, 0x00, 0x00, 0x00, 0x00, 0x00, 0x00, 0x00, 0x00, 0x00, 0x00, 0x00, 0x06,
    0xFF, 0xFF, 0x00, 0x00, 0x00, 0x00, 0x00, 0x00, 0x00, 0x00, 0x00, 0x00, 0x00, 0x00, 0x00, 0x06,
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    0xFF, 0xFF, 0xFF, 0xFF, 0xFF, 0xFF, 0xFF, 0xFF, 0xFF, 0xFF, 0xFF, 0xFF, 0xFF, 0xFF, 0xFF, 0xFF,
  },{
     // Level 4- grooming room
     // 0x11 = door to checkup room 
     // 0x12 = bath 
    0xFF, 0xFF, 0xFF, 0xFF, 0xFF, 0xFF, 0xFF, 0xFF, 0xFF, 0xFF, 0xFF, 0xFF, 0xFF, 0xFF, 0xFF, 0xFF,
    0xFF, 0x00, 0x00, 0x00, 0x00, 0x00, 0x00, 0x00, 0x00, 0x00, 0x00, 0x00, 0x00, 0x00, 0x00, 0xFF,
    0x11, 0x00, 0x00, 0x00, 0x00, 0x00, 0x00, 0x00, 0x00, 0x00, 0x00, 0x00, 0x00, 0x00, 0x00, 0x12,
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    0xFF, 0xFF, 0xFF, 0xFF, 0xFF, 0xFF, 0xFF, 0xFF, 0xFF, 0xFF, 0xFF, 0xFF, 0xFF, 0xFF, 0xFF, 0xFF,
  }, {
   // Level 5- boarding room 
   // 0x13 = main treat 
   // 0x14 = door to boarding room 
    0xFF, 0xFF, 0xFF, 0xFF, 0xFF, 0xFF, 0xFF, 0xFF, 0xFF, 0xFF, 0xFF, 0xFF, 0xFF, 0xFF, 0xFF, 0xFF,
    0xFF, 0x00, 0x00, 0x00, 0x00, 0x00, 0x00, 0x00, 0x00, 0x00, 0x00, 0x00, 0x00, 0x00, 0x00, 0xFF,
    0xFF, 0x00, 0x00, 0x00, 0x00, 0x00, 0x00, 0x00, 0x00, 0x00, 0x00, 0x00, 0x00, 0x00, 0x00, 0xFF,
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    0xFF, 0xFF, 0xFF, 0xFF, 0xFF, 0x14, 0x14, 0x14, 0x14, 0xFF, 0xFF, 0xFF, 0xFF, 0xFF, 0xFF, 0xFF,
  },
};


// Generate an Array of Neighbors for Checking
int neighbors[192][8];

void initNeighbors() {
  for (int i = 0; i < tileW * tileH; i++) {
    // General Rule
    int N = i - tileW; int NE = (i - tileW) + 1;  int E = i + 1;  int SE = (i + tileW) + 1;
    int S = i + tileW; int SW = (i + tileW) - 1;  int W = i - 1;  int NW = (i - tileW) - 1;

    // Exceptions
    if (i < tileW) {
      NW = -1;
      N = -1;
      NE = -1;
    }
    if (i > (tileW * tileH) - (tileW + 1)) {
      SW = -1;
      S = -1;
      SE = -1;
    }
    if (i % tileW == 0) {
      NW = -1;
      W = -1;
      SW = -1;
    }
    if ((i + 1) % tileW == 0) {
      NE = -1;
      E = -1;
      SE = -1;
    }

    neighbors[i][0] = N;  neighbors[i][1] = NE;  neighbors[i][2] = E;  neighbors[i][3] = SE;
    neighbors[i][4] = S;  neighbors[i][5] = SW;  neighbors[i][6] = W;  neighbors[i][7] = NW;
  }
}

boolean checkMove(int currentLevel, int curX, int curY, int curW, int curH) {
  boolean canMove = true;

curX = curX + 2;
curY = curY + 2;

  int curTileX = curX  / tileSize;
  int curTileY = curY / tileSize;
  int curTile = curTileX + (curTileY * tileW);

  //Serial.println(interaction[currentLevel][curTile]);

  for (int i = 0; i < 8; i++) {
    int whichTile = neighbors[curTile][i];                // Get Current Neighbor
    int neighborX = (whichTile % tileW) * tileSize;      // Get X Value of Neighbor
    int neighborY = (whichTile / tileW) * tileSize;      // Get Y Value of Neighbor
    
    boolean isOut = false;
    boolean xMin = false;
    boolean xMax = false;
    boolean yMin = false;
    boolean yMax = false;
  
    if (interaction[currentLevel][whichTile] == 0xFF) {
      isOut = true;
    }
    if (curX < neighborX + tileSize) {
      xMin = true;
    }
    if (curX + curW > neighborX) {
      xMax = true;
    }
    if (curY < neighborY + tileSize) {
      yMin = true;
    }
    if (curY < neighborY + tileSize) {
      yMax = true;
    }


    //if statement that tests all the tests
    if (isOut == true && xMin == true && xMax == true && yMin == true && yMax == true) {
      canMove = false;

    }
//    Serial.print("LVL: "); Serial.print(currentLevel); 
//    Serial.print("\t X: "); Serial.print(curX); Serial.print("\t Y: "); Serial.print(curY); 
//    Serial.print("\t W: ");  Serial.print(curW); Serial.print("\t H: "); Serial.print(curH); 
//    Serial.print("\t CT: "); Serial.print(curTile); Serial.print("\t NT: "); Serial.print(whichTile); 
//    Serial.print("\t NX: "); Serial.print(neighborX); Serial.print("\t NY: "); Serial.print(neighborY); 
//    Serial.print("\t OUT "); Serial.print(isOut);
//    Serial.print("\t xMin: "); Serial.print(xMin); Serial.print("\t xMax: "); Serial.print(xMax); 
//    Serial.print("\t yMin: "); Serial.print(yMin); Serial.print("\t yMax: "); Serial.print(yMax); 
//    Serial.print("\t ? "); Serial.print(canMove);
//    Serial.println();
  }
  
  return canMove;
}
